
#include <MaxMatrix.h>
#include "structs.h"

MaxMatrix m(DATA, LOAD, CLOCK, NUM_OF_MATRIX);      // PARA CONTROLAR LAS MATRICES

char font8x8_basic[129][8] = {
 { 0x00, 0x00, 0x00, 0x00, 0x00, 0x00, 0x00, 0x00}, // U+0000 (nul)
 { 0x00, 0x00, 0x00, 0x00, 0x00, 0x00, 0x00, 0x00}, // U+0001
 { 0x00, 0x00, 0x00, 0x00, 0x00, 0x00, 0x00, 0x00}, // U+0002
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 { 0x66, 0xFF, 0xFF, 0xFF, 0x7E, 0x3C, 0x18, 0x00} // U+0080
};

char blocks[FIELDSIZE/2];           // LOS BLOQUES A ROMPER. ES FIELDSIZE / 2 PORQUE CADA BLOQUE OCUPA 2 PIXELES
char player[FIELDSIZE] = {0};       // EL JUGADOR, VECTOR DE FIELDSIZE POSICIONES QUE COMIENZA EN 0 PORQUE DESPUES SE INICIALIZA AL AZAR
int playerStartsAt;                 // INDICA RAPIDAMENTE DONDE ESTA EL JUGADOR PARA PODER MOSTRARLO RAPIDAMENTE POR LAS MATRICES
int gameOver = 0;                   // INDICA SI SE SIGUE JUGANDO O SE PERDIO
int brokenBlock = -1;               // -1 SI NO SE ROMPIO NINGUN BLOQUE, SINO INDICA EL BLOQUE QUE SE ROMPIO, ES PARA MOSTRAR MAS RAPIDO POR LAS MATRICES
int playerMoved = 0;                // 0 SI NO SE MOVIO, -1 SI SE MOVIO A LA IZQ, 1 SI SE MOVIO A LA DER, ES PARA MOSTRAR MAS RAPIDO POR LAS MATRICES
ball b;                             // LA PELOTA DEL JUEGO 
unsigned long startTime, endTime;   // PARA MEDIR EL TIEMPO DE JUEGO
unsigned long currentTime, lastTime;    // PARA MEDIR EL INTERVALO DE 15 SEGUNDOS POR EL CUAL SE INCREMENTA LA VELOCIDAD DE LA PELOTA
int hasToPrint = 1;                 // PARA VER SI HAY QUE IMPRIMIR LA INFO AL TERMINAR EL JUEGO
int blocksLeft = FIELDSIZE / 2;     // CANTIDAD DE BLOQUES QUE QUEDAN
unsigned long pauseTime;            // PARA DESCONTAR EL TIEMPO AL INTERACTUAR CON LA TERMINAL / VIENDO LA HORA / ETC

#include "constants.h"
#include "Arkanoid.h"
#include "globalVariables.h"
#include "matrixHandler.h"
#include "serialCommunicator.h"

#include "Arduino.h"





void checkInput() {         // CHEQUEO LA ENTRADA
    if(digitalRead(MOVE_LEFT_PIN) == HIGH) {
        movePlayerLeft();
    } else if(digitalRead(MOVE_RIGHT_PIN) == HIGH) {
        movePlayerRight();
    } else if(digitalRead(INTERRUPT_PIN) == HIGH) {
        interrupt();
    }
}


void setup() {
  Serial.begin(115200); // INICIALIZO PUERTO SERIE PARA LA COMUNICACION

  m.init();             // INICIALIZO LA MATRIZ
  m.setIntensity(OFF_INTENSITY);

  pinMode(MOVE_LEFT_PIN, INPUT);     // CONFIGURO PINES QUE VOY A USAR COMO ENTRADA
  pinMode(MOVE_RIGHT_PIN, INPUT);
  pinMode(INTERRUPT_PIN, INPUT);

  initializeGame(&b);       // INICIALIZA EL JUEGO ARKANOID
  initialDisplay(&b);       // MUESTRA TODO POR LAS PANTALLAS POR PRIMERA VEZ. ESTO SE HACE PARA QUE DESPUES SOLO SE TENGA QUE MOSTRAR
                            // LO QUE CAMBIA Y NO ACTUALIZAR TODA LA PANTALLA
  
  Serial.println("BIENVENIDO!");
  Serial.println("Instrucciones: El juego comienza automaticamente. Si genera una interrupcion a traves del pin de interrupciones, las opciones son las siguientes:");
  Serial.println("t: ver tiempo jugado hasta ahora");
  Serial.println("s: interactuar con la shell del Yocto-Linux");
  Serial.println("m: modificar parametros del juego");
  Serial.println("Otra opcion: volver al juego");
  Serial.println();

  startTime = millis();     // PARA CONTAR CUANTO TIEMPO ESTUVO JUGANDO
  lastTime = millis();      // PARA CONTAR LOS 15 SEGUNDOS
}

void loop() {
    while(gameOver == 0 && blocksLeft != 0) {           // MIENTRAS QUE NO HAYA PERDIDO O NO HAYA GANADO
        currentTime = millis();
        if(currentTime - lastTime > 15000) {            // SE FIJA SI PASARON 15 SEGUNDOS DESDE LA ULTIMA VEZ QUE SE AUMENTO LA VELOCIDAD
            increaseBallSpeed(&b);                      // SI ES ASI, SE AUMENTA LA VELOCIDAD Y SE ACTUALIZA EL TIEMPO EN EL QUE ESTO PASO PARA PODER SEGUIR HACIENDO LA CUENTA
            lastTime = currentTime;
            Serial.println("Aumento de velocidad!");
            Serial.println();
        }
            

        checkInput();           // CHEQUEO SI HAY ALGUNA ENTRADA
        moveBall(&b);           // SIEMPRE MUEVO LA PELOTA
        displayPlayer();        // MUESTRO AL JUGADOR, SI ES QUE SE MOVIO
        displayBall(&b);        // MUESTRO LA PELOTA
        displayBrokenBlock();   // MUESTRO AL BLOQUE QUE SE ROMPIO, SI ES QUE HUBO UNO
    }
    endTime = millis();         // CUANTO TIEMPO ESTUVO JUGANDO
    printEndGame();             // MUESTRA TEXTO AL TERMINAR EL JUEGO, YA SEA SI GANO O PERDIO
   
    
}
